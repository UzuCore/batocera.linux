## package/batocera/emulationstation/es-colorful-simplified-dc/Config.in
```kconfig
config BR2_PACKAGE_ES_THEME_COLORFUL
	bool "EmulationStation theme colorful simplified"
	help
	  https://github.com/UzuCore/es-colorful-simplified-dc
```
